/*
 * Copyright 2025, UNSW
 *
 * SPDX-License-Identifier: GPL-2.0-only
 */

/ {
	chosen {
		seL4,elfloader-devices =
		    "serial2",
		    &{/psci},
		    &{/timer};

		seL4,kernel-devices =
		    "serial2",
		    &{/interrupt-controller@fd400000},
		    &{/timer};
	};

	memory@00000000 {
		device_type = "memory";
        reg = <0x00000000 0x00200000 0x00000000 0xefe00000
               0x00000001 0xf0000000 0x00000000 0x10000000>;
	};
};
